## CMakeLists.txt
```
# SPDX-License-Identifier: Apache-2.0

cmake_minimum_required(VERSION 3.20.0)

find_package(Zephyr REQUIRED HINTS $ENV{ZEPHYR_BASE})
project(19_POWER_MANAGEMENT_LAB)

target_sources(app PRIVATE src/main.c)
```

## prj.conf
```kconfig
# nothing here

CONFIG_PM=y
```

## src/main.c
```c
// Source: 19_POWER_MANAGEMENT_LAB.md

#include <zephyr/kernel.h>

void periodic_entry(void *p1, void *p2, void *p3) {
    while (1) {
        printk("PeriodicThread: awake, doing some work...\n");
        k_sleep(K_SECONDS(3)); 
    }
}

K_THREAD_DEFINE(periodic_id, 1024, periodic_entry, NULL, NULL, NULL, 5, 0, 0);

int main(void) {
    return 0;
}
```
